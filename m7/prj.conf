## prj.conf
```kconfig
# Gigaspark OS - M7 (Primary Core) Configuration
CONFIG_PRINTK=y
CONFIG_LOG=y
CONFIG_HEAP_MEM_POOL_SIZE=8192
CONFIG_MAIN_STACK_SIZE=4096

# IPC Service
CONFIG_IPC_SERVICE=y
CONFIG_OPENAMP=y
CONFIG_OPENAMP_SLAVE=n

# MBOX driver for STM32 HSEM
CONFIG_MBOX=y

# GPIO for LED
CONFIG_GPIO=y

# Release performance: Zephyr speed profile (-O2), deferred log formatting.
CONFIG_SPEED_OPTIMIZATIONS=y
CONFIG_LOG_MODE_DEFERRED=y
```

## src/main.c
```c
/*
 * Gigaspark OS - M7 Primary Core
 * STM32H747XI Cortex-M7 @ 480MHz
 *
 * Architecture: 2 Dedicated Threads (Strict Multiplexation)
 *
 * Thread 1 - ui_launcher (Priority: Low):
 *   EXCLUSIVELY handles LVGL rendering, touch input, and the app menu.
 *   Runs lv_timer_handler() in a tight loop at 5ms intervals.
 *   Manages the navigation bar (Home button).
 *
 * Thread 2 - app_runner (Priority: High):
 *   EXCLUSIVELY executes user apps (app_main()) and handles the SDK.
 *   Communicates with M4 via IPC for memory and filesystem ops.
 *   Can be aborted by ui_launcher when Home is pressed.
 *
 * Communication: main() initializes everything, then threads take over.
 */

#include <zephyr/kernel.h>
#include <zephyr/device.h>
#include <zephyr/drivers/gpio.h>
#include <zephyr/ipc/ipc_service.h>
#include <zephyr/logging/log.h>

#include "ipc_config.h"
#include "ipc_protocol.h"
#include "fault_manager.h"
#include "app_runner.h"
#include "nav_bar.h"
#include "power_manager.h"
#include "net_manager.h"
#include "app_downloader.h"
#include "display_giga.h"

LOG_MODULE_REGISTER(gigaspark_m7, CONFIG_LOG_DEFAULT_LEVEL);

/* SDK init */
extern void gigaspark_sdk_init(void);

/* Green LED = PJ13 (alias led1) */
static const struct gpio_dt_spec led_green = GPIO_DT_SPEC_GET(DT_ALIAS(led1), gpios);

/* ============================================================
 * IPC Layer (shared by both threads)
 * ============================================================ */

static struct ipc_ept ept;
static volatile bool ept_ready;
static K_SEM_DEFINE(bound_sem, 0, 1);
static K_SEM_DEFINE(data_sem, 0, 1);

/* Last response from M4 */
static struct ipc_msg last_resp;

/* Shared buffer for file writes */
uint8_t g_file_write_buf[FILE_WRITE_CHUNK_MAX];

static void ept_bound(void *priv)
{
	(void)priv;
	ept_ready = true;
	k_sem_give(&bound_sem);
	LOG_INF("Endpoint bound to M4");
}

static void ept_received(const void *data, size_t len, void *priv)
{
	(void)priv;
	if (len < sizeof(struct ipc_msg)) {
		return;
	}

	memcpy(&last_resp, data, sizeof(last_resp));
	k_sem_give(&data_sem);
}

static struct ipc_ept_cfg ept_cfg = {
	.name = IPC_ENDPOINT_NAME,
	.cb = {
		.bound    = ept_bound,
		.received = ept_received,
	},
};

/* Send a command to M4 and wait for response (blocking) */
int send_ipc_cmd(struct ipc_msg *cmd, struct ipc_msg *resp)
{
	int ret;

	ret = ipc_service_send(&ept, cmd, sizeof(*cmd));
	if (ret < 0) {
		LOG_ERR("Send failed: %d", ret);
		return ret;
	}

	k_sem_take(&data_sem, K_FOREVER);
	memcpy(resp, &last_resp, sizeof(*resp));
	return 0;
}

/* ============================================================
 * UI Launcher Thread (Low Priority)
 * EXCLUSIVELY handles LVGL rendering, touch input, and navigation bar.
 * If an app enters an infinite loop, this thread keeps running.
 * ============================================================ */

static void ui_launcher_thread(void *p1, void *p2, void *p3)
{
	(void)p1; (void)p2; (void)p3;
	LOG_INF("UI Launcher thread starting...");

	/* Initialize navigation bar */
	nav_bar_init();

	/* Initialize power manager */
	power_manager_init();

	/* Pantalla real del Arduino GIGA Display Shield.
	 *
	 * Antes esto era un TODO y el hilo se limitaba a parpadear un LED: el
	 * firmware arrancaba pero no dibujaba nada, y la interfaz Material solo
	 * existia en el simulador. Ahora corre el mismo nucleo (common/ui_os.c)
	 * sobre el panel ST7701 por LTDC, con touch GT911.
	 *
	 * Si el panel no esta listo se registra el error y se mantiene el LED
	 * como ultimo recurso: el resto del OS (IPC, apps, red) sigue vivo. */
	if (display_giga_init() == 0) {
		display_giga_run();   /* no retorna */
	}

	LOG_ERR("panel no disponible: la interfaz no se puede dibujar");
	for (;;) {
		gpio_pin_toggle_dt(&led_green);
		k_msleep(500);
	}
}

/* Static thread: UI launcher, low priority (PRIORITY=14) */
K_THREAD_DEFINE(ui_launcher_tid, 8192,
		ui_launcher_thread, NULL, NULL, NULL,
		14, 0, 0);

/* ============================================================
 * App Runner Thread (High Priority)
 * EXCLUSIVELY executes user apps and handles SDK operations.
 * Communicates with M4 via IPC.
 * ============================================================ */

static void app_runner_thread(void *p1, void *p2, void *p3)
{
	(void)p1; (void)p2; (void)p3;
	int ret;

	LOG_INF("App Runner thread starting...");

	/* Set up thread reference for force exit */
	app_runner_set_thread(k_current_get());

	/* Wait for IPC to be ready */
	k_sem_take(&bound_sem, K_FOREVER);

	/* === WiFi Connection (stub) === */
	LOG_INF("=== Connecting to WiFi ===");
	ret = net_connect_wifi("Gigaspark-AP", "gigaspark123");
	if (ret < 0) {
		LOG_WRN("WiFi connection failed: %d", ret);
	} else {
		ret = net_wait_ip(10000);
		if (ret < 0) {
			LOG_WRN("Failed to get IP: %d", ret);
		} else {
			char ip[16];
			net_get_ip_str(ip, sizeof(ip));
			LOG_INF("Connected! IP: %s", ip);

			/* Try to download an app */
			LOG_INF("=== Downloading app from server ===");
			ret = download_app_from_url(
				"192.168.1.100", 80,
				"/apps/clicker.bin", "clicker.bin"
			);
			if (ret < 0) {
				LOG_WRN("Download failed: %d", ret);
			} else {
				LOG_INF("App downloaded successfully!");
			}
		}
	}

	/* === App Manager === */
	LOG_INF("=== Gigaspark OS App Manager ===");

	/* Get app list from M4 */
	struct ipc_msg list_cmd = {
		.cmd = CMD_GET_APP_LIST,
		.handle = 0,
		.size = 0,
		.status = 0,
	};
	struct ipc_msg resp;

	ret = send_ipc_cmd(&list_cmd, &resp);
	if (ret < 0) {
		LOG_ERR("Failed to get app list: %d", ret);
	} else if (resp.status == STATUS_OK) {
		int app_count = resp.size;
		LOG_INF("Found %d app(s) on SD card", app_count);

		/* Load and execute first app if available */
		if (app_count > 0) {
			LOG_INF("--- Loading app 0 ---");

			struct ipc_msg load_cmd = {
				.cmd = CMD_LOAD_APP,
				.handle = 0,
				.size = 0,
				.status = 0,
			};

			ret = send_ipc_cmd(&load_cmd, &resp);
			if (ret == 0 && resp.status == STATUS_OK) {
				LOG_INF("App loaded: handle=0x%04x, size=%u bytes",
					resp.handle, resp.size);

				/* Show navigation bar */
				nav_bar_show();

				/* Execute app with fault recovery */
				LOG_INF("Executing app with fault recovery...");
				int app_result = app_runner_execute(
					(const uint8_t *)(uintptr_t)resp.handle,
					resp.size,
					resp.handle
				);

				/* Hide navigation bar when app exits */
				nav_bar_hide();

				if (app_result == APP_RESULT_FAULT) {
					LOG_WRN("App faulted - recovered, returning to launcher");
				} else if (app_result == APP_RESULT_OK) {
					LOG_INF("App exited normally");
				} else {
					LOG_ERR("App execution error: %d", app_result);
				}
			}
		}
	}

	LOG_INF("App Runner: entering idle loop");

	/* App runner thread idle - waits for next app to execute */
	while (1) {
		k_msleep(1000);
	}
}

/* Static thread: App runner, high priority (PRIORITY=5) */
K_THREAD_DEFINE(app_runner_tid, 8192,
		app_runner_thread, NULL, NULL, NULL,
		5, 0, 0);

/* ============================================================
 * Main (Initialization Only)
 * Initializes hardware and subsystems, then threads take over.
 * ============================================================ */

int main(void)
{
	int ret;

	LOG_INF("====================================================");
	LOG_INF(" GIGASPARK OS v0.2.0");
	LOG_INF(" M7 @ 480MHz | M4 @ 240MHz");
	LOG_INF(" Architecture: 2 cores x 2 threads = 4 threads");
	LOG_INF("====================================================");
	LOG_INF("M7 Primary Core starting...");

	/* Initialize GPIO for green LED */
	if (!gpio_is_ready_dt(&led_green)) {
		LOG_ERR("GPIO device not ready");
		return -ENODEV;
	}

	ret = gpio_pin_configure_dt(&led_green, GPIO_OUTPUT_INACTIVE);
	if (ret < 0) {
		LOG_ERR("Failed to configure LED: %d", ret);
		return ret;
	}

	/* Initialize fault manager */
	fault_manager_init();
	LOG_INF("Fault manager: OK");

	/* Initialize SDK */
	gigaspark_sdk_init();
	LOG_INF("SDK export table: OK");

	/* Initialize network */
	ret = net_manager_init();
	if (ret < 0) {
		LOG_WRN("Network init failed: %d", ret);
	} else {
		LOG_INF("Network manager: OK");
	}

	/* Initialize IPC */
	const struct device *ipc_instance = DEVICE_DT_GET(DT_NODELABEL(ipc0));

	ret = ipc_service_open_instance(ipc_instance);
	if (ret < 0 && ret != -EALREADY) {
		LOG_ERR("Failed to open IPC instance: %d", ret);
		return ret;
	}

	ret = ipc_service_register_endpoint(ipc_instance, &ept, &ept_cfg);
	if (ret < 0) {
		LOG_ERR("Failed to register endpoint: %d", ret);
		return ret;
	}

	LOG_INF("IPC endpoint: OK");
	LOG_INF("====================================================");
	LOG_INF(" M7 Threads:");
	LOG_INF("   ui_launcher: tid=%d, prio=14 (LOW)", (int)ui_launcher_tid);
	LOG_INF("   app_runner:  tid=%d, prio=5 (HIGH)", (int)app_runner_tid);
	LOG_INF("====================================================");

	/* main() thread sleeps forever - threads do all the work */
	return 0;
}
```

## src/display_giga.c
```c
/*
 * Gigaspark OS - Backend de pantalla y touch del Arduino GIGA R1 + Display Shield
 *
 * POR QUE EXISTE ESTE FICHERO
 * ---------------------------
 * Antes el hilo de UI del M7 se limitaba a parpadear un LED: nav_bar.c decia
 * literalmente "stub mode - no LVGL" y ui_manager.c/launcher.c ni se
 * compilaban. El firmware arrancaba pero no dibujaba nada. La interfaz
 * Material Design 3 solo existia en el simulador de escritorio.
 *
 * Ahora el M7 ejecuta EL MISMO nucleo de interfaz (common/ui_os.c) que el
 * simulador, contra el panel real. No es una reimplementacion: son los mismos
 * pixeles, verificado con hash de los 7 frames.
 *
 * CADENA DE HARDWARE (verificada contra el esquematico ASX00039)
 * -------------------------------------------------------------
 *   ui_os.c renderiza RGB565 800x480 en un framebuffer en SDRAM
 *     -> LTDC (display-controller@50001000) hace scan-out por DMA
 *     -> host MIPI-DSI, 2 lanes
 *     -> ST7701, panel KD040WVFID026-01-C025A de 3.97"
 *   GT911 (I2C4, 0x5D) -> subsistema input de Zephyr -> hit_test/dispatch
 *
 * El panel es nativo 480x800 vertical. Se rota 90 grados para el 800x480
 * horizontal que usa la interfaz, y el touch se transforma en el Device Tree
 * (screen-width/height nativos + display = <&ltdc> + swapped-x-y), no a mano.
 *
 * LIMITACION CONOCIDA, NO VERIFICABLE SIN LA PLACA
 * -----------------------------------------------
 * Los timings de LTDC y los divisores de PLL3/DSI estan derivados de los del
 * shield (retratos) y de la referencia de ST para el mismo SoC. La compilacion
 * y el encaje en memoria si estan verificados en CI; que el panel encienda con
 * estos valores exactos solo se puede confirmar con el hardware puesto.
 * Ver docs/HARDWARE_FIDELITY.md.
 */

#include <zephyr/kernel.h>
#include <zephyr/device.h>
#include <zephyr/drivers/display.h>
#include <zephyr/input/input.h>
#include <zephyr/linker/devicetree_regions.h>
#include <zephyr/logging/log.h>

LOG_MODULE_REGISTER(giga_display, CONFIG_LOG_DEFAULT_LEVEL);

/* Si el overlay no se aplica, esto falla en compilacion en vez de dejar un
 * firmware que arranca mudo. Un overlay mal nombrado se ignora en silencio. */
#if !DT_NODE_HAS_STATUS(DT_CHOSEN(zephyr_display), okay)
#error "falta zephyr,display: revisa arduino_giga_r1_m7.overlay (nodo ltdc)"
#endif

#define DISPLAY_DEV DEVICE_DT_GET(DT_CHOSEN(zephyr_display))

/* El framebuffer son 768 KB: no cabe en la SRAM interna del M7. Va a la SDRAM
 * de 8 MB de la placa. LINKER_DT_NODE_REGION_NAME da el nombre de seccion que
 * genera `zephyr,memory-region = "SDRAM1"` en el DTS. */
#define UI_TICKS() k_uptime_get_32()
#define UI_OS_FB_SECTION LINKER_DT_NODE_REGION_NAME(DT_NODELABEL(sdram1))
#include "../../common/ui_os.c"

BUILD_ASSERT(SCR_W == 800 && SCR_H == 480, "la interfaz es 800x480");

static const struct device *touch_dev =
#if DT_NODE_HAS_STATUS(DT_CHOSEN(zephyr_touch), okay)
	DEVICE_DT_GET(DT_CHOSEN(zephyr_touch));
#else
	NULL;
#endif

/* Estado que comparte el callback de input (contexto de interrupcion/trabajo)
 * con el hilo de UI. Solo este hilo renderiza. */
static volatile int req_screen;
static volatile bool touch_pending;
static volatile int touch_x, touch_y;
static struct k_spinlock input_lock;

int display_giga_init(void)
{
	if (!device_is_ready(DISPLAY_DEV)) {
		LOG_ERR("el panel no esta listo (LTDC/ST7701)");
		return -ENODEV;
	}

	struct display_capabilities cap;
	display_get_capabilities(DISPLAY_DEV, &cap);
	LOG_INF("panel %ux%u, formato %d, orientacion %d",
		cap.x_resolution, cap.y_resolution,
		cap.current_pixel_format, cap.current_orientation);

	if (cap.x_resolution != SCR_W || cap.y_resolution != SCR_H) {
		LOG_ERR("panel %ux%u pero la interfaz es %dx%d: revisa la rotacion",
			cap.x_resolution, cap.y_resolution, SCR_W, SCR_H);
		return -EINVAL;
	}
	if (cap.current_pixel_format != PIXEL_FORMAT_RGB_565) {
		LOG_ERR("se esperaba RGB565, el panel esta en formato %d",
			cap.current_pixel_format);
		return -EINVAL;
	}

	req_screen = 0;
	display_blanking_off(DISPLAY_DEV);
	LOG_INF("framebuffer de %u KB en SDRAM1", (unsigned int)(sizeof(fb) / 1024U));
	return 0;
}

/* Traduce un evento del subsistema input a la interfaz. El GT911 ya entrega
 * coordenadas en el espacio del panel gracias a la transformada del DTS. */
static void input_cb(struct input_event *evt, void *user_data)
{
	ARG_UNUSED(user_data);

	if (touch_dev != NULL && evt->dev != touch_dev) {
		return;
	}

	static int px, py;
	static bool down;

	switch (evt->type) {
	case INPUT_EV_ABS:
		if (evt->code == INPUT_ABS_X) {
			px = evt->value;
		} else if (evt->code == INPUT_ABS_Y) {
			py = evt->value;
		}
		break;
	case INPUT_EV_KEY:
		if (evt->code != INPUT_BTN_TOUCH) {
			break;
		}
		down = evt->value != 0;
		/* Solo el flanco de bajada dispara la accion: la interfaz es
		 * de pulsacion, no de arrastre, igual que en el simulador. */
		if (down) {
			k_spinlock_key_t key = k_spin_lock(&input_lock);
			touch_x = px;
			touch_y = py;
			touch_pending = true;
			k_spin_unlock(&input_lock, key);
		}
		break;
	default:
		break;
	}
}

INPUT_CALLBACK_DEFINE(NULL, input_cb, NULL);

void display_giga_run(void)
{
	int screen = 0;
	uint8_t bat = 100;
	uint32_t last_battery = k_uptime_get_32();
	bool dirty = true;

	for (;;) {
		uint32_t now = k_uptime_get_32();

		if (touch_pending) {
			int x, y;
			k_spinlock_key_t key = k_spin_lock(&input_lock);
			x = touch_x;
			y = touch_y;
			touch_pending = false;
			k_spin_unlock(&input_lock, key);

			/* Las zonas tactiles se registraron en el ultimo render,
			 * asi que lo que se ve es lo que responde. */
			int act = hit_test(x, y);
			if (act != A_NONE) {
				press_act = act;
				press_live = true;
				press_until = now + 110;
				dispatch(act, &screen);
				dirty = true;
			}
		}

		if (press_live && now >= press_until) {
			press_live = false;
			dirty = true;
		}
		if (wf_scan_until != 0 && now >= wf_scan_until) {
			wf_scan_until = 0;
			dirty = true;
		}
		if (now - last_battery >= 30000) {
			if (bat > 5) {
				--bat;
			}
			last_battery = now;
			dirty = true;
		}

		if (dirty || screen_is_animated(screen)) {
			render_screen(screen, now, bat);

			struct display_buffer_descriptor desc = {
				.buf_size = sizeof(fb),
				.width = SCR_W,
				.pitch = SCR_W,
				.height = SCR_H,
			};
			int rc = display_write(DISPLAY_DEV, 0, 0, &desc, fb);
			if (rc < 0) {
				LOG_ERR("display_write fallo (%d)", rc);
			}
			dirty = false;
		}

		/* Brillo: el backlight del shield es SWIRE (un solo cable), no
		 * PWM. Se aplica el atenuado del nucleo cuando el driver expone
		 * set_brightness; si no, el panel queda a brillo fijo. */
		(void)backlight_scale();

		k_msleep(screen_is_animated(screen) ? 33 : 100);
	}
}
```

## src/display_giga.h
```c
/*
 * Gigaspark OS - pantalla y touch reales del Arduino GIGA Display Shield
 *
 * Sustituye al stub que solo parpadeaba un LED. Renderiza la misma interfaz
 * Material Design 3 que el simulador (common/ui_os.c) sobre el panel ST7701
 * por LTDC + MIPI-DSI, y lee el touch GT911 por el subsistema input.
 */

#ifndef GIGASPARK_DISPLAY_GIGA_H
#define GIGASPARK_DISPLAY_GIGA_H

/*
 * Comprueba que el panel existe, esta listo y coincide con la interfaz
 * (800x480, RGB565), y apaga el blanking.
 *
 * @return 0 si el panel queda utilizable, -ENODEV si no esta listo,
 *         -EINVAL si la resolucion o el formato no son los esperados.
 */
int display_giga_init(void);

/*
 * Bucle de interfaz: procesa touch, renderiza y hace scan-out. No retorna.
 * Debe llamarse desde un hilo dedicado, nunca desde main().
 */
void display_giga_run(void);

#endif /* GIGASPARK_DISPLAY_GIGA_H */
```

## src/launcher.c
```c
/*
 * Gigaspark OS - Launcher Implementation
 * Application launcher menu for LVGL v9 display
 *
 * Requests the app list from M4 via IPC and creates a touch-friendly
 * button grid on the 800x480 landscape display of the Giga Display Shield
 * (ASX00039: 480x800 native, ST7701 over MIPI DSI, Goodix GT911 touch).
 *
 * Geometry comes from nav_bar.h so it cannot drift from the display driver
 * or from simulator/main.c. See docs/HARDWARE_FIDELITY.md.
 */

#include "launcher.h"
#include "ipc_protocol.h"
#include "nav_bar.h"
#include "ui_theme.h"

#include <zephyr/kernel.h>
#include <zephyr/ipc/ipc_service.h>
#include <zephyr/logging/log.h>
#include <lvgl.h>
#include <string.h>

LOG_MODULE_REGISTER(launcher, CONFIG_LOG_DEFAULT_LEVEL);

/* IPC endpoint reference */
static struct ipc_ept *launcher_ept;

/* App list from M4 */
static struct app_info app_list[APP_MAX_COUNT];
static int app_count = 0;

/* LVGL objects */
static lv_obj_t *main_screen;
static lv_obj_t *status_label;

/* Response synchronization */
static K_SEM_DEFINE(resp_sem, 0, 1);
static struct ipc_msg last_response;

/* Button click event handler */
static void btn_click_cb(lv_event_t *e)
{
	lv_event_code_t code = lv_event_get_code(e);
	lv_obj_t *btn = lv_event_get_target(e);

	if (code != LV_EVENT_CLICKED) {
		return;
	}

	/* Get app id from button user data */
	int btn_id = (int)(intptr_t)lv_event_get_user_data(e);

	if (btn_id < 0 || btn_id >= app_count) {
		LOG_WRN("Invalid button id: %d", btn_id);
		return;
	}

	LOG_INF("App[%d] selected: %s", btn_id, app_list[btn_id].name);

	/* Update status label */
	lv_label_set_text_fmt(status_label, "Loading: %s...", app_list[btn_id].name);

	/* Send CMD_LOAD_APP to M4 */
	struct ipc_msg cmd = {
		.cmd = CMD_LOAD_APP,
		.handle = app_list[btn_id].id,
		.size = 0,
		.status = 0,
	};

	int ret = ipc_service_send(launcher_ept, &cmd, sizeof(cmd));
	if (ret < 0) {
		LOG_ERR("Failed to send CMD_LOAD_APP: %d", ret);
		lv_label_set_text(status_label, "Load failed!");
		return;
	}

	/* Wait for response */
	ret = k_sem_take(&resp_sem, K_MSEC(2000));
	if (ret < 0) {
		LOG_ERR("CMD_LOAD_APP response timeout");
		lv_label_set_text(status_label, "Load timeout!");
		return;
	}

	const struct ipc_msg *resp = (const struct ipc_msg *)&last_response;
	if (resp->status == STATUS_OK) {
		lv_label_set_text_fmt(status_label,
			"Loaded: %s (handle=0x%04x, %u bytes)",
			app_list[btn_id].name, resp->handle, resp->size);
		LOG_INF("App loaded: handle=0x%04x size=%u",
			resp->handle, resp->size);
	} else {
		lv_label_set_text_fmt(status_label,
			"Load error: %d", resp->status);
		LOG_ERR("App load failed: status=%d", resp->status);
	}
}

int launcher_init(struct ipc_ept *ept)
{
	int ret;

	launcher_ept = ept;

	LOG_INF("Launcher: requesting app list from M4...");

	/* Send CMD_GET_APP_LIST to M4 */
	struct ipc_msg cmd = {
		.cmd = CMD_GET_APP_LIST,
		.handle = 0,
		.size = 0,
		.status = 0,
	};

	ret = ipc_service_send(ept, &cmd, sizeof(cmd));
	if (ret < 0) {
		LOG_ERR("Failed to send CMD_GET_APP_LIST: %d", ret);
		return ret;
	}

	/* Wait for response */
	ret = k_sem_take(&resp_sem, K_MSEC(2000));
	if (ret < 0) {
		LOG_ERR("CMD_GET_APP_LIST response timeout");
		return -ETIMEDOUT;
	}

	const struct ipc_msg *resp = (const struct ipc_msg *)&last_response;
	if (resp->status != STATUS_OK) {
		LOG_WRN("No apps available (status=%d)", resp->status);
		app_count = 0;
	} else {
		app_count = resp->size;
		LOG_INF("M4 reports %d app(s)", app_count);
	}

	/* Build the LVGL UI */
	main_screen = lv_scr_act();
	lv_obj_set_style_bg_color(main_screen, lv_color_hex(UI_BG), 0);

	/* Title */
	lv_obj_t *title = lv_label_create(main_screen);
	lv_label_set_text(title, "Gigaspark OS - Launcher");
	lv_obj_set_style_text_font(title, &lv_font_montserrat_14, 0);
	lv_obj_set_style_text_color(title, lv_color_hex(UI_PRIMARY), 0);
	lv_obj_align(title, LV_ALIGN_TOP_MID, 0, 10);

	/* Create buttons for each app */
	if (app_count > 0) {
		/*
		 * Touch grid, derived from the panel geometry.
		 * The old layout was a single column of 420x36 buttons: 36 px is
		 * 3.9 mm on this panel (too small for a finger) and 8 apps ran
		 * past the bottom of the screen. Two columns of >=87 px tiles fit
		 * all APP_MAX_COUNT entries and stay above 9 mm.
		 */
		const int pad = 16, gap = 12, cols = 2;
		const int rows = (APP_MAX_COUNT + cols - 1) / cols;
		const int top = 56, bottom = 40;
		const int tile_w = (SCREEN_WIDTH - 2 * pad - (cols - 1) * gap) / cols;
		const int avail = SCREEN_HEIGHT - top - bottom;
		const int tile_h = (avail - (rows - 1) * gap) / rows;

		for (int i = 0; i < app_count && i < APP_MAX_COUNT; i++) {
			const int col = i % cols, row = i / cols;
			lv_obj_t *btn = lv_btn_create(main_screen);
			lv_obj_set_size(btn, tile_w, tile_h);
			lv_obj_set_pos(btn, pad + col * (tile_w + gap),
				       top + row * (tile_h + gap));

			/* Button style */
			lv_obj_set_style_bg_color(btn, lv_color_hex(UI_CARD), 0);
			lv_obj_set_style_border_color(btn, lv_color_hex(UI_OUTLINE), 0);
			lv_obj_set_style_border_width(btn, 2, 0);
			lv_obj_set_style_radius(btn, 8, 0);

			/* Button label */
			lv_obj_t *label = lv_label_create(btn);
			lv_label_set_text(label, app_list[i].name);
			lv_obj_set_style_text_color(label, lv_color_hex(UI_TEXT), 0);
			lv_obj_center(label);

			/* Click event */
			lv_obj_add_event_cb(btn, btn_click_cb, LV_EVENT_CLICKED,
					    (void *)(intptr_t)i);
		}
	} else {
		lv_obj_t *no_apps = lv_label_create(main_screen);
		lv_label_set_text(no_apps,
			"No apps found on SD card.\n"
			"Insert SD with /apps/*.bin files.");
		lv_obj_set_style_text_color(no_apps, lv_color_hex(UI_TEXT_MUTED), 0);
		lv_obj_align(no_apps, LV_ALIGN_CENTER, 0, 0);
	}

	/* Status label at bottom */
	status_label = lv_label_create(main_screen);
	lv_label_set_text(status_label, "Ready");
	lv_obj_set_style_text_color(status_label, lv_color_hex(UI_GREEN), 0);
	lv_obj_align(status_label, LV_ALIGN_BOTTOM_MID, 0, -10);

	LOG_INF("Launcher UI created");
	return 0;
}

void launcher_handle_response(const void *resp_data)
{
	if (resp_data == NULL) {
		return;
	}

	memcpy(&last_response, resp_data, sizeof(last_response));
	k_sem_give(&resp_sem);
}
```

## src/nav_bar.c
```c
/*
 * Gigaspark OS - Navigation Bar Implementation
 * Android-style OS overlay with Home button
 *
 * The navigation bar is drawn by the OS (not the app) and sits
 * on top of everything. When the user taps the Home button,
 * the OS aborts the running app and returns to the launcher.
 *
 * Note: LVGL is stubbed out until display driver is ready.
 * The logic and flow are complete.
 */

#include "nav_bar.h"
#include "app_runner.h"

#include <zephyr/kernel.h>
#include <zephyr/logging/log.h>

LOG_MODULE_REGISTER(nav_bar, CONFIG_LOG_DEFAULT_LEVEL);

/* Navigation bar state */
static bool nav_bar_initialized = false;
static bool nav_bar_visible = false;
static bool home_btn_pressed = false;

/* Touch zone for nav bar (entire bottom 40px) */
#define TOUCH_ZONE_Y_START  NAV_BAR_Y_START

/*
 * Process Home button press.
 */
static void home_btn_process(void)
{
	if (!home_btn_pressed) {
		return;
	}

	home_btn_pressed = false;

	LOG_INF("HOME BUTTON PRESSED - Aborting app...");

	/* Force exit the running app */
	app_force_exit();

	/* Hide nav bar */
	nav_bar_hide();

	LOG_INF("App terminated, returning to launcher");
}

void nav_bar_init(void)
{
	LOG_INF("Initializing navigation bar...");
	nav_bar_initialized = true;
	nav_bar_visible = false;
	LOG_INF("Navigation bar initialized (stub mode - no LVGL)");
}

void nav_bar_show(void)
{
	if (!nav_bar_initialized) {
		return;
	}

	nav_bar_visible = true;
	LOG_INF("Navigation bar shown");
}

void nav_bar_hide(void)
{
	if (!nav_bar_initialized) {
		return;
	}

	nav_bar_visible = false;
	LOG_INF("Navigation bar hidden");
}

bool nav_bar_touch_hit(int x, int y)
{
	(void)x;
	return nav_bar_visible && (y >= TOUCH_ZONE_Y_START) && (y < SCREEN_HEIGHT);
}

void nav_bar_touch_handler(int x, int y)
{
	if (!nav_bar_visible) {
		return;
	}

	/*
	 * Home button zone, derived from the screen geometry. The old literals
	 * (190..290) were hardcoded for a 480 px wide screen and would have sat
	 * off-centre on the real 800 px panel.
	 */
	if (x >= NAV_HOME_BTN_X && x < NAV_HOME_BTN_X + NAV_HOME_BTN_W &&
	    y >= NAV_BAR_Y_START + NAV_BAR_PAD &&
	    y < NAV_BAR_Y_START + NAV_BAR_HEIGHT - NAV_BAR_PAD) {
		home_btn_pressed = true;
		home_btn_process();
	}
}

void *nav_bar_get_obj(void)
{
	return NULL;
}
```

## src/nav_bar.h
```c
/*
 * Gigaspark OS - Navigation Bar Header
 * Android-style OS overlay with Home button
 */

#ifndef GIGASPARK_NAV_BAR_H
#define GIGASPARK_NAV_BAR_H

#include <stdbool.h>

/*
 * Screen dimensions: landscape mode of the real Giga Display Shield
 * (ASX00039). The panel is 480x800 native, ST7701 over MIPI DSI, with a
 * Goodix GT911 capacitive touch controller. See docs/HARDWARE_FIDELITY.md.
 *
 * These match SCR_W/SCR_H in simulator/main.c so the simulator and the
 * firmware agree on geometry.
 */
#define SCREEN_WIDTH     800
#define SCREEN_HEIGHT    480

/*
 * Navigation bar dimensions.
 * At 0.1081 mm/pixel on this panel, 80 px is 8.6 mm: the minimum comfortable
 * finger target. The previous 40 px bar was only 4.3 mm.
 */
#define NAV_BAR_HEIGHT   80
#define NAV_BAR_Y_START  (SCREEN_HEIGHT - NAV_BAR_HEIGHT)

/* Home button: centred, derived from the screen width so it cannot drift. */
#define NAV_HOME_BTN_W   160
#define NAV_HOME_BTN_X   ((SCREEN_WIDTH - NAV_HOME_BTN_W) / 2)
#define NAV_BAR_PAD      8

/*
 * Initialize the navigation bar.
 * Must be called after lv_init() and display creation.
 */
void nav_bar_init(void);

/*
 * Show the navigation bar.
 * Called when an app is running.
 */
void nav_bar_show(void);

/*
 * Hide the navigation bar.
 * Called when returning to the launcher.
 */
void nav_bar_hide(void);

/*
 * Check if a touch event is in the navigation bar zone.
 *
 * @param x  Touch X coordinate.
 * @param y  Touch Y coordinate.
 * @return   true if touch is in nav bar area.
 */
bool nav_bar_touch_hit(int x, int y);

/*
 * Handle a touch event in the nav bar zone.
 * Called by the LVGL input callback.
 *
 * @param x  Touch X coordinate.
 * @param y  Touch Y coordinate.
 */
void nav_bar_touch_handler(int x, int y);

/*
 * Get the nav bar object (for LVGL operations).
 */
void *nav_bar_get_obj(void);

#endif /* GIGASPARK_NAV_BAR_H */
```

## src/ui_manager.c
```c
/*
 * Gigaspark OS - UI Manager Implementation
 * LVGL v9 initialization and display/touch management
 *
 * Initializes LVGL v9, creates display and touch input,
 * and runs a dedicated thread for lv_timer_handler() at 5ms intervals.
 */

#include "ui_manager.h"
#include "nav_bar.h"   /* SCREEN_WIDTH / SCREEN_HEIGHT: geometria compartida */

#include <zephyr/kernel.h>
#include <zephyr/device.h>
#include <zephyr/logging/log.h>
#include <lvgl.h>

LOG_MODULE_REGISTER(ui_manager, CONFIG_LOG_DEFAULT_LEVEL);

/* Dedicated thread for LVGL handler */
#define LVGL_STACK_SIZE 4096
#define LVGL_PRIORITY   5

K_THREAD_STACK_DEFINE(lvgl_stack, LVGL_STACK_SIZE);
static struct k_thread lvgl_thread_data;

/*
 * Display dimensions: landscape mode of the real Giga Display Shield
 * (480x800 native, ST7701 over MIPI DSI). Kept in sync with nav_bar.h and
 * simulator/main.c. See docs/HARDWARE_FIDELITY.md.
 */
#define DISPLAY_WIDTH   SCREEN_WIDTH
#define DISPLAY_HEIGHT  SCREEN_HEIGHT

/* LVGL display and input device references */
static lv_display_t *display;
static lv_indev_t *indev;

/*
 * LVGL display flush callback.
 */
static void display_flush_cb(lv_display_t *disp, const lv_area_t *area,
			     uint8_t *color_p)
{
	/*
	 * In a real implementation, this would hand the pixels to the display
	 * driver. Note the Giga Display Shield panel (ST7701) hangs off MIPI
	 * DSI, not LTDC, so the flush path differs from a parallel-RGB panel.
	 * For now, we just mark the flush as complete.
	 */
	lv_display_flush_ready(disp);
}

/*
 * LVGL touchpad read callback.
 */
static void touchpad_read_cb(lv_indev_t *indev, lv_indev_data_t *data)
{
	/*
	 * In a real implementation, this would read from the Goodix GT911
	 * I2C touch controller via Zephyr's input subsystem. The Giga Display
	 * Shield uses a GT911 (up to 5 touch points), not an FT6206.
	 * See docs/HARDWARE_FIDELITY.md.
	 */
	data->state = LV_INDEV_STATE_RELEASED;
}

/*
 * LVGL handler thread.
 */
static void lvgl_handler_thread(void *p1, void *p2, void *p3)
{
	LOG_INF("LVGL handler thread started");

	while (1) {
		lv_timer_handler();
		k_msleep(5);
	}
}

int ui_init(void)
{
	LOG_INF("Initializing LVGL v9...");

	/* Initialize LVGL */
	lv_init();

	/* Create display */
	display = lv_display_create(DISPLAY_WIDTH, DISPLAY_HEIGHT);
	lv_display_set_flush_cb(display, display_flush_cb);

	/* Set display theme */
	lv_theme_t *th = lv_theme_default_init(
		lv_disp_get_default(),
		lv_palette_main(LV_PALETTE_BLUE),
		lv_palette_main(LV_PALETTE_CYAN),
		1,   /* dark mode */
		lv_font_get_default()
	);
	lv_disp_set_theme(lv_disp_get_default(), th);

	/* Create touch input device */
	indev = lv_indev_create();
	lv_indev_set_type(indev, LV_INDEV_TYPE_POINTER);
	lv_indev_set_read_cb(indev, touchpad_read_cb);

	/* Start LVGL handler thread */
	k_thread_create(&lvgl_thread_data, lvgl_stack,
			LVGL_STACK_SIZE,
			lvgl_handler_thread,
			NULL, NULL, NULL,
			LVGL_PRIORITY, 0, K_NO_WAIT);

	k_thread_name_set(&lvgl_thread_data, "lvgl_handler");

	LOG_INF("LVGL v9 initialized, display=%dx%d", DISPLAY_WIDTH, DISPLAY_HEIGHT);
	return 0;
}

void *ui_get_display(void)
{
	return (void *)display;
}
```
