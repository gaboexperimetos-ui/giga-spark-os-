## CMakeLists.txt
```
# SPDX-License-Identifier: Apache-2.0
# Copyright 2026 Gigaspark OS

cmake_minimum_required(VERSION 3.20.0)

find_package(Zephyr REQUIRED HINTS $ENV{ZEPHYR_BASE})
project(gigaspark_m4)

# Strict compilation: treat all warnings as errors (Fase 18)
target_compile_options(app PRIVATE -Werror -Wall -Wextra)

target_sources(app PRIVATE
	src/main.c
	src/mem_engine.c
	src/zram_comp.c
	src/sd_swap.c
	src/fs_manager.c
)
target_include_directories(app PRIVATE
		${CMAKE_CURRENT_SOURCE_DIR}
	${CMAKE_CURRENT_SOURCE_DIR}/../common
	${CMAKE_CURRENT_SOURCE_DIR}/../common/include
)
```

## prj.conf
```kconfig
# Gigaspark OS - M4 (Remote Core) Configuration
CONFIG_PRINTK=y
CONFIG_LOG=y
CONFIG_LOG_TIMESTAMP_64BIT=y
CONFIG_LOG_THREAD_ID_PREFIX=y
CONFIG_LOG_BACKEND_SHOW_COLOR=y
CONFIG_LOG_PROCESS_THREAD_STACK_SIZE=2048
CONFIG_HEAP_MEM_POOL_SIZE=8192
CONFIG_MAIN_STACK_SIZE=4096

# IPC Service
CONFIG_IPC_SERVICE=y
CONFIG_OPENAMP=y
CONFIG_OPENAMP_MASTER=n

# MBOX driver for STM32 HSEM
CONFIG_MBOX=y

# SPI driver for SD card
CONFIG_SPI=y

# Disk access (SD card)
CONFIG_DISK_ACCESS=y

# Filesystem
CONFIG_FILE_SYSTEM=y
CONFIG_FAT_FILESYSTEM_ELM=y
CONFIG_FS_FATFS_LFN=y
CONFIG_FILE_SYSTEM_MAX_FILE_NAME=24
CONFIG_FS_FATFS_CUSTOM_MOUNT_POINT_COUNT=1

# Release performance: Zephyr speed profile (-O2), deferred log formatting.
CONFIG_SPEED_OPTIMIZATIONS=y
CONFIG_LOG_MODE_DEFERRED=y
```

## src/main.c
```c
/*
 * Gigaspark OS - M4 Remote Core
 * STM32H747XI Cortex-M4 @ 240MHz
 *
 * Architecture: 2 Dedicated Threads (Strict Multiplexation)
 *
 * Thread 1 - ipc_listener (Priority: High):
 *   EXCLUSIVELY receives RPMsg messages and queues commands.
 *   EXCLUSIVELY sends responses back to M7.
 *   Never processes commands directly.
 *
 * Thread 2 - mem_engine (Priority: Medium):
 *   EXCLUSIVELY processes commands from the queue.
 *   Runs all compression, decompression, SD swap, and filesystem ops.
 *   Puts responses into resp_msgq for ipc_listener to send.
 *
 * Communication: k_msgq between ISR callback and mem_engine thread.
 * If mem_engine is compressing a 1KB block, ipc_listener
 * keeps receiving new commands without blocking.
 */

#include <zephyr/kernel.h>
#include <zephyr/device.h>
#include <zephyr/ipc/ipc_service.h>
#include <zephyr/logging/log.h>

#include "ipc_config.h"
#include "ipc_protocol.h"
#include "mem_engine.h"
#include "fs_manager.h"

LOG_MODULE_REGISTER(gigaspark_m4, CONFIG_LOG_DEFAULT_LEVEL);

/* ============================================================
 * Shared State
 * ============================================================ */

#define CMD_QUEUE_SIZE  8

/* Request item for the command queue */
struct cmd_item {
	struct ipc_msg req;
};

/* Message queues */
K_MSGQ_DEFINE(cmd_msgq, sizeof(struct cmd_item), CMD_QUEUE_SIZE, 4);
K_MSGQ_DEFINE(resp_msgq, sizeof(struct ipc_msg), CMD_QUEUE_SIZE, 4);

/* Semaphores */
static K_SEM_DEFINE(bound_sem, 0, 1);
static K_SEM_DEFINE(init_sem, 0, 1);

/* IPC endpoint */
static struct ipc_ept ept;
static volatile bool ept_ready;

/* Buffers for IPC responses (owned by mem_engine thread) */
static uint8_t io_buf[MEM_IO_MAX];
static uint8_t app_buf[APP_BINARY_MAX_SIZE];
uint8_t g_file_write_buf[FILE_WRITE_CHUNK_MAX];
uint8_t g_media_read_buf[MEDIA_READ_CHUNK_MAX];

/* ============================================================
 * IPC Callbacks (run in ISR context, must be FAST)
 * ============================================================ */

static void ept_bound(void *priv)
{
	(void)priv;
	ept_ready = true;
	k_sem_give(&bound_sem);
	LOG_INF("Endpoint bound to M7");
}

static void ept_received(const void *data, size_t len, void *priv)
{
	(void)priv;
	if (len < sizeof(struct ipc_msg)) {
		return;
	}

	/* Copy the message into our queue item (safe from ISR) */
	struct cmd_item item;
	memcpy(&item.req, data, sizeof(struct ipc_msg));

	/* Non-blocking put into the queue */
	int ret = k_msgq_put(&cmd_msgq, &item, K_NO_WAIT);
	if (ret < 0) {
		LOG_WRN("Command queue full, dropping cmd 0x%02x", item.req.cmd);
		return;
	}

}

/* IPC endpoint configuration */
static struct ipc_ept_cfg ept_cfg = {
	.name = IPC_ENDPOINT_NAME,
	.cb = {
		.bound    = ept_bound,
		.received = ept_received,
	},
};

/* ============================================================
 * IPC Listener Thread (High Priority = 5)
 * Receives RPMsg, queues commands, sends responses.
 * ============================================================ */

static void ipc_listener_thread(void *p1, void *p2, void *p3)
{
	(void)p1; (void)p2; (void)p3;
	const struct device *ipc_instance;
	int ret;

	LOG_INF("IPC Listener starting...");

	/* Initialize IPC */
	ipc_instance = DEVICE_DT_GET(DT_NODELABEL(ipc0));

	ret = ipc_service_open_instance(ipc_instance);
	if (ret < 0 && ret != -EALREADY) {
		LOG_ERR("Failed to open IPC instance: %d", ret);
		return;
	}

	ret = ipc_service_register_endpoint(ipc_instance, &ept, &ept_cfg);
	if (ret < 0) {
		LOG_ERR("Failed to register endpoint: %d", ret);
		return;
	}

	LOG_INF("Waiting for M7 handshake...");
	k_sem_take(&bound_sem, K_FOREVER);
	LOG_INF("M4 IPC Listener ready.");

	/* Main loop: send responses that mem_engine has prepared */
	while (1) {
		struct ipc_msg resp;
		/* The message queue already provides blocking wait + synchronization. */
		if (k_msgq_get(&resp_msgq, &resp, K_FOREVER) == 0) {
			ret = ipc_service_send(&ept, &resp, sizeof(resp));
			if (ret < 0) {
				LOG_ERR("Failed to send response: %d", ret);
			}
		}
	}
}

/* Static thread: IPC listener, high priority (PRIORITY=5) */
K_THREAD_DEFINE(ipc_listener_tid, 2048,
		ipc_listener_thread, NULL, NULL, NULL,
		5, 0, 0);

/* ============================================================
 * Memory Engine Thread (Medium Priority = 7)
 * Reads commands from queue, processes them, sends responses.
 * All heavy work (compress, decompress, swap, filesystem) runs here.
 * ============================================================ */

static void process_command(const struct ipc_msg *req, struct ipc_msg *resp)
{
	resp->cmd = CMD_RESPONSE;

	switch (req->cmd) {
	case CMD_ALLOC: {
		uint16_t handle = mem_alloc(req->size);
		resp->status = (handle != MEM_HANDLE_INVALID)
			       ? STATUS_OK : STATUS_ERR_NOMEM;
		resp->handle = handle;
		resp->size = req->size;
		LOG_DBG("CMD_ALLOC size=%u -> handle=0x%04x", req->size, handle);
		break;
	}
	case CMD_FREE: {
		int ret = mem_free(req->handle);
		resp->status = (ret == 0) ? STATUS_OK : STATUS_ERR_BAD_HANDLE;
		resp->handle = req->handle;
		resp->size = 0;
		LOG_DBG("CMD_FREE handle=0x%04x -> %d", req->handle, ret);
		break;
	}
	case CMD_READ: {
		size_t to_read = req->size;
		if (to_read > MEM_IO_MAX) {
			to_read = MEM_IO_MAX;
		}
		size_t actual = mem_read(req->handle, io_buf, to_read);
		resp->handle = req->handle;
		resp->size = actual;
		resp->status = (actual > 0) ? STATUS_OK : STATUS_ERR_READ_FAILED;
		LOG_DBG("CMD_READ handle=0x%04x -> %u bytes", req->handle, actual);
		break;
	}
	case CMD_WRITE: {
		int ret = mem_write(req->handle, &req->size, sizeof(req->size));
		resp->status = (ret == 0) ? STATUS_OK : STATUS_ERR_WRITE_FAILED;
		resp->handle = req->handle;
		resp->size = 0;
		LOG_DBG("CMD_WRITE handle=0x%04x -> %d", req->handle, ret);
		break;
	}
	case CMD_GET_APP_LIST: {
		int count = fs_get_app_count();
		resp->status = (count > 0) ? STATUS_OK : STATUS_ERR_NO_APPS;
		resp->size = count;
		resp->handle = 0;
		LOG_INF("CMD_GET_APP_LIST -> %d apps", count);
		break;
	}
	case CMD_LOAD_APP: {
		uint8_t app_id = (uint8_t)(req->handle & 0xFF);
		size_t loaded = fs_load_app(app_id, app_buf, sizeof(app_buf));

		if (loaded == 0) {
			resp->status = STATUS_ERR_APP_NOT_FOUND;
			resp->handle = MEM_HANDLE_INVALID;
			resp->size = 0;
			LOG_INF("CMD_LOAD_APP id=%u -> NOT FOUND", app_id);
		} else {
			uint16_t mem_handle = mem_alloc(loaded);
			if (mem_handle == MEM_HANDLE_INVALID) {
				resp->status = STATUS_ERR_NOMEM;
				resp->handle = MEM_HANDLE_INVALID;
				resp->size = 0;
				LOG_INF("CMD_LOAD_APP id=%u -> NO MEMORY", app_id);
			} else {
				mem_write(mem_handle, app_buf, loaded);
				resp->status = STATUS_OK;
				resp->handle = mem_handle;
				resp->size = loaded;
				LOG_INF("CMD_LOAD_APP id=%u -> handle=0x%04x size=%u",
					app_id, mem_handle, loaded);
			}
		}
		break;
	}
	case CMD_FILE_OPEN: {
		char filename[32];
		snprintf(filename, sizeof(filename), "app_%04x.bin", req->handle);

		int fd = fs_file_open(filename);
		if (fd >= 0) {
			resp->status = STATUS_OK;
			resp->handle = (uint16_t)fd;
			resp->size = 0;
			LOG_INF("CMD_FILE_OPEN %s -> fd=%d", filename, fd);
		} else {
			resp->status = STATUS_ERR_FILE_OPEN;
			resp->handle = MEM_HANDLE_INVALID;
			resp->size = 0;
			LOG_ERR("CMD_FILE_OPEN %s -> %d", filename, fd);
		}
		break;
	}
	case CMD_FILE_WRITE: {
		extern uint8_t g_file_write_buf[FILE_WRITE_CHUNK_MAX];

		int written = fs_file_write(req->handle, g_file_write_buf, req->size);
		if (written > 0) {
			resp->status = STATUS_OK;
			resp->size = written;
		} else {
			resp->status = STATUS_ERR_FILE_WRITE;
			resp->size = 0;
			LOG_ERR("CMD_FILE_WRITE fd=%d -> %d", req->handle, written);
		}
		break;
	}
	case CMD_FILE_CLOSE: {
		int ret = fs_file_close(req->handle);
		if (ret == 0) {
			resp->status = STATUS_OK;
			LOG_INF("CMD_FILE_CLOSE fd=%d -> OK", req->handle);
		} else {
			resp->status = STATUS_ERR_FILE_CLOSE;
			LOG_ERR("CMD_FILE_CLOSE fd=%d -> %d", req->handle, ret);
		}
		break;
	}
	case CMD_MEDIA_OPEN: {
		/* El nombre del archivo viene en el campo handle como indice
		 * simplificado. En un caso real se enviaria en el payload. */
		char filename[32];
		snprintf(filename, sizeof(filename), "media_%04x.dat", req->handle);

		int fd = fs_media_open(filename);
		if (fd >= 0) {
			resp->status = STATUS_OK;
			resp->handle = (uint16_t)fd;
			resp->size = 0;
			LOG_INF("CMD_MEDIA_OPEN %s -> fd=%d", filename, fd);
		} else {
			resp->status = STATUS_ERR_MEDIA_OPEN;
			resp->handle = MEM_HANDLE_INVALID;
			LOG_ERR("CMD_MEDIA_OPEN %s -> %d", filename, fd);
		}
		break;
	}
	case CMD_MEDIA_READ: {
		extern uint8_t g_media_read_buf[MEDIA_READ_CHUNK_MAX];

		size_t bytes_read = 0;
		int ret = fs_media_read(req->handle, g_media_read_buf,
					req->size, &bytes_read);
		if (ret == 0 && bytes_read > 0) {
			resp->status = STATUS_OK;
			resp->size = bytes_read;
		} else {
			resp->status = STATUS_ERR_MEDIA_READ;
			resp->size = 0;
		}
		break;
	}
	case CMD_MEDIA_SEEK: {
		/* offset en resp->size, whence en resp->handle (0=SET,1=CUR,2=END) */
		int ret = fs_media_seek(req->handle, (int32_t)req->size,
					req->handle & 0xFF);
		if (ret == 0) {
			resp->status = STATUS_OK;
			LOG_INF("CMD_MEDIA_SEEK fd=%d offset=%d -> OK",
				req->handle, req->size);
		} else {
			resp->status = STATUS_ERR_MEDIA_SEEK;
			LOG_ERR("CMD_MEDIA_SEEK fd=%d -> %d", req->handle, ret);
		}
		break;
	}
	case CMD_MEDIA_CLOSE: {
		int ret = fs_media_close(req->handle);
		if (ret == 0) {
			resp->status = STATUS_OK;
			LOG_INF("CMD_MEDIA_CLOSE fd=%d -> OK", req->handle);
		} else {
			resp->status = STATUS_ERR_MEDIA_CLOSE;
			LOG_ERR("CMD_MEDIA_CLOSE fd=%d -> %d", req->handle, ret);
		}
		break;
	}
	default:
		LOG_WRN("Unknown cmd: 0x%02x", req->cmd);
		resp->status = STATUS_ERR_BAD_HANDLE;
		resp->handle = MEM_HANDLE_INVALID;
		resp->size = 0;
		break;
	}
}

static void mem_engine_thread(void *p1, void *p2, void *p3)
{
	(void)p1; (void)p2; (void)p3;
	struct cmd_item item;
	struct ipc_msg resp;
	int ret;

	LOG_INF("Memory Engine thread waiting for initialization...");
	k_sem_take(&init_sem, K_FOREVER);
	LOG_INF("Memory Engine thread starting...");

	while (1) {
		/* Block directly on the queue; no duplicate semaphore wakeup. */
		ret = k_msgq_get(&cmd_msgq, &item, K_FOREVER);
		if (ret != 0) {
			continue;
		}

		LOG_DBG("Processing cmd 0x%02x", item.req.cmd);

		/* Process the command (this is where heavy work happens) */
		process_command(&item.req, &resp);

		/* Put response in the response queue */
		ret = k_msgq_put(&resp_msgq, &resp, K_NO_WAIT);
		if (ret < 0) {
			LOG_ERR("Response queue full, dropping response");
			continue;
		}

	}
}

/* Static thread: Memory engine, medium priority (PRIORITY=7) */
K_THREAD_DEFINE(mem_engine_tid, 4096,
		mem_engine_thread, NULL, NULL, NULL,
		7, 0, 0);

/* ============================================================
 * Main (Initialization Only)
 * Initializes hardware and subsystems, then the threads take over.
 * main() thread has lowest priority and does nothing after init.
 * ============================================================ */

int main(void)
{
	int ret;

	LOG_INF("Gigaspark OS M4 Remote Core starting...");
	LOG_INF("Architecture: 2 dedicated threads (ipc_listener + mem_engine)");

	/* Initialize memory engine (includes SD swap init) */
	mem_init();

	/* Initialize filesystem manager (mount SD, scan apps) */
	ret = fs_init();
	if (ret < 0) {
		LOG_WRN("Filesystem init failed: %d (SD not available)", ret);
	} else {
		LOG_INF("Filesystem ready, %d app(s) found", fs_get_app_count());
	}

	k_sem_give(&init_sem);
	LOG_INF("M4 subsystems initialized. Threads are now running.");
	LOG_INF("  ipc_listener: tid=%d, prio=5 (HIGH)", (int)ipc_listener_tid);
	LOG_INF("  mem_engine:   tid=%d, prio=7 (MEDIUM)", (int)mem_engine_tid);

	/* main() thread sleeps forever - threads do all the work */
	return 0;
}
```

## src/mem_engine.c
```c
/*
 * Gigaspark OS - M4 bounded buddy allocator
 *
 * 4 KiB pool, 32..4096 byte blocks, at most 64 live handles.
 * Free-block bitmaps replace scans of individual blocks. Search is bounded
 * by 8 orders x 4 words; handle allocation and usage accounting are O(1).
 * All operations belong to the single M4 memory-engine thread.
 */
#include "mem_engine.h"
#include "bitops.h"

#include <string.h>
#include <zephyr/logging/log.h>

LOG_MODULE_REGISTER(mem_engine, CONFIG_LOG_DEFAULT_LEVEL);

#define POOL_SIZE    4096U
#define MIN_ORDER    5U
#define MAX_ORDER    12U
#define NUM_ORDERS   (MAX_ORDER - MIN_ORDER + 1U)
#define MAX_HANDLES  64U
#define BLOCK_SIZE(order) (UINT32_C(1) << (order))
#define BLOCKS_AT(order)  (POOL_SIZE >> (order))

static uint8_t __attribute__((aligned(32))) pool[POOL_SIZE];
/* Only whole, unsplit free blocks are set. Unused high bits stay zero. */
static uint32_t free_bits[NUM_ORDERS][4];
static uint32_t handle_free_bits[2];
static uint32_t used_bytes;

struct handle_entry {
	uint32_t offset;
	uint32_t size;
	uint8_t order;
};
static struct handle_entry handles[MAX_HANDLES];

static void bitmap_set(uint32_t *words, unsigned index)
{
	words[index / 32U] |= UINT32_C(1) << (index % 32U);
}

static void bitmap_clear(uint32_t *words, unsigned index)
{
	words[index / 32U] &= ~(UINT32_C(1) << (index % 32U));
}

static int bitmap_test(const uint32_t *words, unsigned index)
{
	return (words[index / 32U] & (UINT32_C(1) << (index % 32U))) != 0;
}

static int find_free(unsigned min_order, unsigned *out_order, unsigned *out_index)
{
	for (unsigned order = min_order; order <= MAX_ORDER; ++order) {
		uint32_t *words = free_bits[order - MIN_ORDER];
		for (unsigned word = 0; word < 4; ++word) {
			if (words[word] != 0) {
				*out_order = order;
				*out_index = word * 32U + giga_ctz32(words[word]);
				return 0;
			}
		}
	}
	return -1;
}

static unsigned split_block(unsigned from_order, unsigned to_order, unsigned index)
{
	while (from_order > to_order) {
		bitmap_clear(free_bits[from_order - MIN_ORDER], index);
		index *= 2U;
		bitmap_set(free_bits[from_order - MIN_ORDER - 1U], index);
		bitmap_set(free_bits[from_order - MIN_ORDER - 1U], index + 1U);
		--from_order;
	}
	bitmap_clear(free_bits[to_order - MIN_ORDER], index);
	return index;
}

static void merge_block(unsigned order, unsigned index)
{
	while (order < MAX_ORDER) {
		unsigned buddy = index ^ 1U;
		if (!bitmap_test(free_bits[order - MIN_ORDER], buddy)) break;
		bitmap_clear(free_bits[order - MIN_ORDER], index);
		bitmap_clear(free_bits[order - MIN_ORDER], buddy);
		index /= 2U;
		++order;
		bitmap_set(free_bits[order - MIN_ORDER], index);
	}
}

static int alloc_handle(void)
{
	for (unsigned word = 0; word < 2; ++word) {
		if (handle_free_bits[word] != 0) {
			unsigned index = word * 32U + giga_ctz32(handle_free_bits[word]);
			bitmap_clear(handle_free_bits, index);
			return (int)index;
		}
	}
	return -1;
}

static int valid_handle(uint32_t handle)
{
	return handle > 0 && handle <= MAX_HANDLES &&
	       !bitmap_test(handle_free_bits, handle - 1U);
}

void mem_engine_init(void)
{
	memset(free_bits, 0, sizeof(free_bits));
	memset(handles, 0, sizeof(handles));
	handle_free_bits[0] = UINT32_MAX;
	handle_free_bits[1] = UINT32_MAX;
	used_bytes = 0;
	bitmap_set(free_bits[MAX_ORDER - MIN_ORDER], 0);
	LOG_INF("Buddy allocator: %u bytes, %u orders", POOL_SIZE, NUM_ORDERS);
}

uint32_t mem_alloc(uint32_t size)
{
	if (size == 0 || size > POOL_SIZE) return 0;
	unsigned target = MIN_ORDER;
	while (BLOCK_SIZE(target) < size) ++target;

	unsigned order, index;
	if (find_free(target, &order, &index) < 0) return 0;
	/* Reserve the handle BEFORE splitting: exhaustion must not leak a block. */
	int slot = alloc_handle();
	if (slot < 0) return 0;

	index = split_block(order, target, index);
	handles[slot].offset = index * BLOCK_SIZE(target);
	handles[slot].size = BLOCK_SIZE(target);
	handles[slot].order = (uint8_t)target;
	used_bytes += handles[slot].size;
	return (uint32_t)slot + 1U;
}

int mem_free(uint32_t handle)
{
	if (!valid_handle(handle)) return -1;
	unsigned slot = handle - 1U;
	unsigned order = handles[slot].order;
	unsigned index = handles[slot].offset >> order;
	used_bytes -= handles[slot].size;
	bitmap_set(handle_free_bits, slot);
	bitmap_set(free_bits[order - MIN_ORDER], index);
	merge_block(order, index);
	return 0;
}

int mem_get_info(uint32_t handle, uint32_t *addr, uint32_t *size)
{
	if (!valid_handle(handle)) return -1;
	const struct handle_entry *entry = &handles[handle - 1U];
	/* The firmware ABI is 32-bit. The intermediate uintptr_t also permits
	 * host tests on a 64-bit PC (where only the low address bits fit). */
	if (addr) *addr = (uint32_t)(uintptr_t)&pool[entry->offset];
	if (size) *size = entry->size;
	return 0;
}

uint8_t mem_get_usage(void)
{
	return (uint8_t)((used_bytes * 100U) / POOL_SIZE);
}

size_t mem_read(uint32_t handle, void *buf, size_t buf_size)
{
	if (!valid_handle(handle) || !buf) return 0;
	const struct handle_entry *entry = &handles[handle - 1U];
	size_t len = buf_size < entry->size ? buf_size : entry->size;
	memcpy(buf, &pool[entry->offset], len);
	return len;
}

int mem_write(uint32_t handle, const void *data, size_t data_len)
{
	if (!valid_handle(handle) || !data) return -1;
	const struct handle_entry *entry = &handles[handle - 1U];
	size_t len = data_len < entry->size ? data_len : entry->size;
	memcpy(&pool[entry->offset], data, len);
	return 0;
}
```

## src/mem_engine.h
```c
/*
 * Gigaspark OS - Memory Engine Header (Fase 16: Buddy Allocator)
 * Asignador buddy con bitmaps; sin eviccion LRU en esta capa.
* No es thread-safe: usar desde el hilo memory-engine del M4.
 */

#ifndef GIGASPARK_MEM_ENGINE_H
#define GIGASPARK_MEM_ENGINE_H

#include <stdint.h>
#include <stddef.h>

/*
 * Inicializa el motor de memoria y el buddy allocator.
 * Debe llamarse una vez antes de cualquier operacion alloc/free.
 */
void mem_engine_init(void);

/*
 * Alias para compatibilidad con codigo existente.
 */
#define mem_init mem_engine_init

/*
 * Asigna memoria usando el buddy allocator.
 *
 * @param size  Numero de bytes a asignar (debe ser > 0 y <= 4096).
 * @return      Handle (ID opaco) en exito, o 0 si falla.
 */
uint32_t mem_alloc(uint32_t size);

/*
 * Libera un bloque de memoria previamente asignado.
 *
 * @param handle  Handle retornado por mem_alloc().
 * @return        0 si ok, -1 si falla.
 */
int mem_free(uint32_t handle);

/*
 * Lee datos de un bloque a un buffer.
 *
 * @param handle    Handle retornado por mem_alloc().
 * @param buf       Buffer destino.
 * @param buf_size  Tamano del buffer destino.
 * @return          Numero de bytes leidos, o 0 si error.
 */
size_t mem_read(uint32_t handle, void *buf, size_t buf_size);

/*
 * Escribe datos en un bloque existente.
 *
 * @param handle    Handle retornado por mem_alloc().
 * @param data      Datos fuente a escribir.
 * @param data_len  Numero de bytes a escribir.
 * @return          0 si ok, -1 si error.
 */
int mem_write(uint32_t handle, const void *data, size_t data_len);

/*
 * Obtiene informacion de un handle.
 *
 * @param handle  Handle a consultar.
 * @param addr    Puntero para la direccion (o NULL).
 * @param size    Puntero para el tamano (o NULL).
 * @return        0 si ok, -1 si el handle es invalido.
 */
int mem_get_info(uint32_t handle, uint32_t *addr, uint32_t *size);

/*
 * Retorna el porcentaje de memoria usada (0-100).
 */
uint8_t mem_get_usage(void);

#endif /* GIGASPARK_MEM_ENGINE_H */
```

## src/zram_comp.c
```c
/*
 * Gigaspark OS - bounded RLE cache with LRU replacement
 *
 * Wire format unchanged: [count 1..255][byte] pairs. Incompressible data
 * expands 2x. This is a volatile cache: eviction discards data; it does NOT
 * provide persistent swap. Keep metadata contiguous for cheap searches.
 */
#include "zram_comp.h"
#include "bitops.h"

#include <string.h>
#include <zephyr/logging/log.h>

LOG_MODULE_REGISTER(zram_comp, CONFIG_LOG_DEFAULT_LEVEL);

#define ZRAM_MAX_BLOCKS 32U
#define ZRAM_BLOCK_SIZE 512U
#define ZRAM_ALL_BLOCKS UINT32_MAX

struct zram_entry {
	uint32_t handle;
	uint32_t size_orig;
	uint32_t size_comp;
	uint32_t lru_counter;
	uint32_t in_use;
};

static struct zram_entry zram_table[ZRAM_MAX_BLOCKS];
static uint8_t zram_data[ZRAM_MAX_BLOCKS][ZRAM_BLOCK_SIZE];
static uint32_t zram_used_bits;
static uint32_t lru_global_counter;

static int lru_find(uint32_t handle)
{
	for (unsigned index = 0; index < ZRAM_MAX_BLOCKS; ++index) {
		if (zram_table[index].in_use && zram_table[index].handle == handle)
			return (int)index;
	}
	return -1;
}

/* At counter wrap, preserve relative order instead of making new entries old. */
static void lru_normalize(void)
{
	uint8_t ranks[ZRAM_MAX_BLOCKS] = {0};
	uint32_t bits = zram_used_bits;
	while (bits != 0) {
		unsigned i = giga_ctz32(bits);
		uint32_t others = zram_used_bits;
		uint8_t rank = 1;
		while (others != 0) {
			unsigned j = giga_ctz32(others);
			if (zram_table[j].lru_counter < zram_table[i].lru_counter) ++rank;
			others &= others - 1U;
		}
		ranks[i] = rank;
		bits &= bits - 1U;
	}
	bits = zram_used_bits;
	while (bits != 0) {
		unsigned i = giga_ctz32(bits);
		zram_table[i].lru_counter = ranks[i];
		bits &= bits - 1U;
	}
	lru_global_counter = ZRAM_MAX_BLOCKS;
}

static void lru_touch(unsigned index)
{
	if (lru_global_counter == UINT32_MAX) lru_normalize();
	zram_table[index].lru_counter = ++lru_global_counter;
}

static int lru_find_victim(void)
{
	int victim = -1;
	uint32_t oldest = UINT32_MAX;
	for (unsigned index = 0; index < ZRAM_MAX_BLOCKS; ++index) {
		if (zram_table[index].in_use && zram_table[index].lru_counter < oldest) {
			oldest = zram_table[index].lru_counter;
			victim = (int)index;
		}
	}
	return victim;
}

static void lru_remove(unsigned index)
{
	zram_used_bits &= ~(UINT32_C(1) << index);
	zram_table[index].in_use = 0;
}

static int lru_insert(uint32_t handle, const uint8_t *data,
		      uint32_t size_orig, uint32_t size_comp)
{
	if (size_comp > ZRAM_BLOCK_SIZE) return -1;
	int slot = lru_find(handle);
	if (slot < 0) {
		if (zram_used_bits == ZRAM_ALL_BLOCKS) {
			slot = lru_find_victim();
			LOG_WRN("LRU discard: handle=%u", zram_table[slot].handle);
			lru_remove((unsigned)slot);
		} else {
			slot = (int)giga_ctz32(~zram_used_bits);
		}
		zram_used_bits |= UINT32_C(1) << (unsigned)slot;
		zram_table[slot].in_use = 1;
		zram_table[slot].handle = handle;
	}
	zram_table[slot].size_orig = size_orig;
	zram_table[slot].size_comp = size_comp;
	memcpy(zram_data[slot], data, size_comp);
	lru_touch((unsigned)slot);
	return 0;
}

size_t zram_compress(const uint8_t *src, size_t src_len,
		     uint8_t *dst, size_t dst_len)
{
	if (src_len == 0) return 0;
	if (!src || !dst || dst_len < 2) return 0;
	size_t si = 0, di = 0;
	while (si < src_len) {
		uint8_t current = src[si];
		uint8_t count = 1;
		while (si + count < src_len && src[si + count] == current && count < 255)
			++count;
		if (dst_len - di < 2) return 0;
		dst[di++] = count;
		dst[di++] = current;
		si += count;
	}
	return di;
}

size_t zram_decompress(const uint8_t *src, size_t src_len,
		       uint8_t *dst, size_t dst_len)
{
	if (src_len == 0) return 0;
	/* Reject malformed input before writing anything. */
	if (!src || !dst || (src_len & 1U) != 0) return 0;
	size_t di = 0;
	for (size_t si = 0; si < src_len; si += 2) {
		size_t count = src[si];
		if (count == 0 || count > dst_len - di) return 0;
		memset(dst + di, src[si + 1], count);
		di += count;
	}
	return di;
}

size_t zram_compress_and_store(uint32_t handle, const uint8_t *src, size_t src_len)
{
	/* Handle zero is the eviction/not-found sentinel. */
	if (handle == 0 || !src || src_len == 0 || src_len > ZRAM_BLOCK_SIZE * 2U)
		return 0;
	uint8_t compressed[ZRAM_BLOCK_SIZE];
	size_t comp_len = zram_compress(src, src_len, compressed, sizeof(compressed));
	if (comp_len == 0 || lru_insert(handle, compressed, (uint32_t)src_len,
				      (uint32_t)comp_len) < 0)
		return 0;
	LOG_DBG("zRAM store: handle=%u orig=%u comp=%u", handle,
		(unsigned)src_len, (unsigned)comp_len);
	return comp_len;
}

size_t zram_retrieve(uint32_t handle, uint8_t *dst, size_t dst_len)
{
	int index = lru_find(handle);
	if (index < 0 || !dst) return 0;
	size_t len = zram_decompress(zram_data[index], zram_table[index].size_comp,
				     dst, dst_len);
	if (len != 0) lru_touch((unsigned)index);
	LOG_DBG("zRAM retrieve: handle=%u decomp=%u", handle, (unsigned)len);
	return len;
}

uint32_t zram_evict_block(uint32_t handle)
{
	int index = lru_find(handle);
	if (index < 0) return 0;
	uint32_t evicted = zram_table[index].handle;
	lru_remove((unsigned)index);
	return evicted;
}

void zram_get_stats(uint8_t *used, uint8_t *total, uint32_t *counter)
{
	if (used) {
		uint32_t bits = zram_used_bits;
		uint8_t count = 0;
		while (bits != 0) {
			++count;
			bits &= bits - 1U;
		}
		*used = count;
	}
	if (total) *total = (uint8_t)ZRAM_MAX_BLOCKS;
	if (counter) *counter = lru_global_counter;
}

void zram_reset(void)
{
	/* Invalid payload bytes need not be erased; only metadata is reachable. */
	memset(zram_table, 0, sizeof(zram_table));
	zram_used_bits = 0;
	lru_global_counter = 0;
}
```

## src/zram_comp.h
```c
/*
 * Gigaspark OS - zRAM Compression Header (Fase 16: LRU)
 * Compresion RLE con politica de eviccion LRU.
 * Cache volatil en C; una eviccion descarta datos, NO los guarda en SD.
* Las funciones de tabla comparten estado: usar un unico hilo propietario.
 */

#ifndef GIGASPARK_ZRAM_COMP_H
#define GIGASPARK_ZRAM_COMP_H

#include <stdint.h>
#include <stddef.h>

/*
 * Comprime datos usando RLE.
 *
 * Formato: pares [count][byte]. count es 1-255.
 * Si un run excede 255, se divide en multiples pares.
 * Bytes no repetidos se almacenan como [1][byte].
 *
 * @param src       Datos a comprimir.
 * @param src_len   Longitud de datos fuente.
 * @param dst       Buffer de salida para datos comprimidos.
 * @param dst_len   Tamano del buffer de salida.
 * @return          Bytes escritos en dst, o 0 si falla.
 */
size_t zram_compress(const uint8_t *src, size_t src_len,
		     uint8_t *dst, size_t dst_len);

/*
 * Descomprime datos codificados en RLE.
 *
 * @param src       Datos comprimidos.
 * @param src_len   Longitud de datos comprimidos.
 * @param dst       Buffer de salida para datos descomprimidos.
 * @param dst_len   Tamano del buffer de salida.
 * @return          Bytes escritos en dst, o 0 si falla.
 * Una longitud impar o un count cero se rechazan antes de escribir.
 */
size_t zram_decompress(const uint8_t *src, size_t src_len,
		       uint8_t *dst, size_t dst_len);

/*
 * Comprime y almacena un bloque en la tabla LRU.
 * Si la tabla esta llena, expulsa la victima LRU.
 *
 * @param handle    Handle del bloque a comprimir (distinto de 0).
 * @param src       Datos fuente.
 * @param src_len   Longitud de datos fuente.
 * @return          Tamano comprimido, o 0 si falla.
 */
size_t zram_compress_and_store(uint32_t handle,
			       const uint8_t *src, size_t src_len);

/*
 * Recupera y descomprime un bloque de la tabla LRU.
 * Actualiza el timestamp LRU del bloque.
 *
 * @param handle    Handle del bloque a recuperar.
 * @param dst       Buffer de salida.
 * @param dst_len   Tamano del buffer de salida.
 * @return          Tamano descomprimido, o 0 si no existe.
 */
size_t zram_retrieve(uint32_t handle, uint8_t *dst, size_t dst_len);

/*
 * Expulsa explicitamente un bloque del zRAM.
 *
 * @param handle    Handle del bloque a expulsar.
 * @return          Handle expulsado, o 0 si no existia.
 */
uint32_t zram_evict_block(uint32_t handle);

/*
 * Retorna estadisticas del zRAM.
 *
 * @param used      Puntero para bloques en uso (o NULL).
 * @param total     Puntero para bloques totales (o NULL).
 * @param counter   Puntero para contador LRU global (o NULL).
 */
void zram_get_stats(uint8_t *used, uint8_t *total, uint32_t *counter);

/*
 * Reinicia la tabla LRU (para tests).
 */
void zram_reset(void);

#endif /* GIGASPARK_ZRAM_COMP_H */
```
